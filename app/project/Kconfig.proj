## app/project/Kconfig.proj
```kconfig
#APP specific configuration.
config BF0_HCPU
    bool
    default y

config CUSTOM_MEM_MAP
    bool 
	select custom_mem_map
	default y    

config XIAOZHI_USING_MQTT
    bool "xiaozhi_using_mqtt"
	default n

config CONFIG_IOT_PROTOCOL_MCP
    bool "using mcp protocol"
	default y 

comment "------------Project configuration-----------"



config BLUETOOTH_NAME
    string "Bluetooth device name"
    default "sifli-pan"
    help
        Specify the Bluetooth device name for the application.

config BT_NAME_MAC_ENABLE
    bool "Append the MAC address to the Bluetooth name"
    default n
    help
        Append the MAC address to the Bluetooth name, such as "sifli-pan-12:34:56:78:9a:bc".

# KWS
config KWS_ENABLE_DEFAULT
    bool "Enable KWS by default"
    default n
    help
        Enable KWS (Keyword Spotting) by default in the application. 
```
